/*
 * Copyright (c) 2020 Pete Johanson
 *
 * SPDX-License-Identifier: MIT
 */

#include "split.dtsi"

&kscan0 {
	col-gpios
		= <&xiao_d 4 GPIO_ACTIVE_LOW>   //Col0
		, <&xiao_d 5 GPIO_ACTIVE_LOW>   //Col1
		, <&xiao_d 6 GPIO_ACTIVE_LOW>   //Col2
		, <&xiao_d 7 GPIO_ACTIVE_LOW>   //Col3
		, <&xiao_d 8 GPIO_ACTIVE_LOW>   //Col4
		;
};

