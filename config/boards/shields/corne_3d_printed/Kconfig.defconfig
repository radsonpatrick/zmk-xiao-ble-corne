## config/boards/shields/corne_3d_printed/Kconfig.defconfig
```kconfig
if SHIELD_SPLIT_LEFT

config ZMK_KEYBOARD_NAME
	default "corner_printed"

config ZMK_SPLIT_BLE_ROLE_CENTRAL
	default y

endif

if SHIELD_SPLIT_RIGHT

config ZMK_KEYBOARD_NAME
	default "corne_3d_printed_R"
	
endif

if SHIELD_SPLIT_LEFT || SHIELD_SPLIT_RIGHT

config ZMK_SPLIT
	default y

endif
```

## config/boards/shields/split/Kconfig.defconfig
```kconfig
if SHIELD_SPLIT_LEFT

config ZMK_KEYBOARD_NAME
	default "split"

config ZMK_SPLIT_BLE_ROLE_CENTRAL
	default y

endif

if SHIELD_SPLIT_RIGHT

config ZMK_KEYBOARD_NAME
	default "Split Right"
	
endif

if SHIELD_SPLIT_LEFT || SHIELD_SPLIT_RIGHT

config ZMK_SPLIT
	default y

endif
```

## config/boards/shields/split/Kconfig.shield
```kconfig
# Copyright (c) 2020 Pete Johanson
# SPDX-License-Identifier: MIT

config SHIELD_SPLIT_LEFT
	def_bool $(shields_list_contains,split_left)

config SHIELD_SPLIT_RIGHT
	def_bool $(shields_list_contains,split_right)
```
